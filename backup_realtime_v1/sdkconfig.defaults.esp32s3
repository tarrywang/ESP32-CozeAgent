## example/ESP-IDF-v5.4/06_I2SCodec/components/SensorLib/Kconfig
```kconfig
menu "SensorLib Configuration"

    config SENSORLIB_ESP_IDF_NEW_API
        bool "Use ESP-IDF 5.x new I2C master API"
        default y if IDF_VERSION_MAJOR >= 5
        help
            Enable this option to use the new I2C master driver API
            introduced in ESP-IDF 5.0. Required for ESP-IDF 5.4+
            where the legacy driver was removed.

endmenu
```

## example/ESP-IDF-v5.4/06_I2SCodec/sdkconfig.defaults
```kconfig
# Target ESP32-S3
CONFIG_IDF_TARGET="esp32s3"

CONFIG_EXAMPLE_MODE_MUSIC=y
CONFIG_EXAMPLE_VOICE_VOLUME=80

# SensorLib - use legacy I2C API to share bus with codec
# CONFIG_SENSORLIB_ESP_IDF_NEW_API is not set

# Disable legacy I2C backward compatibility in esp_codec_dev
# CONFIG_CODEC_I2C_BACKWARD_COMPATIBLE is not set

# Flash size (16MB for this board)
CONFIG_ESPTOOLPY_FLASHSIZE_16MB=y

# Custom partition table with larger app partition (2MB)
CONFIG_PARTITION_TABLE_CUSTOM=y
CONFIG_PARTITION_TABLE_CUSTOM_FILENAME="partitions.csv"
```

## sdkconfig.defaults
```kconfig
# ESP32-S3 Coze Voice Agent - SDK Configuration Defaults
# Target: Waveshare ESP32-S3 1.75-inch AMOLED Dev Board

# ============================================
# Target Configuration
# ============================================
CONFIG_IDF_TARGET="esp32s3"
CONFIG_IDF_TARGET_ESP32S3=y

# ============================================
# CPU and Memory Configuration
# ============================================
CONFIG_ESP_DEFAULT_CPU_FREQ_MHZ_240=y
CONFIG_ESP_DEFAULT_CPU_FREQ_MHZ=240

# PSRAM Configuration (8MB PSRAM)
CONFIG_SPIRAM=y
CONFIG_SPIRAM_TYPE_AUTO=y
CONFIG_SPIRAM_MODE_OCT=y
CONFIG_SPIRAM_SPEED_80M=y
CONFIG_SPIRAM_BOOT_INIT=y
CONFIG_SPIRAM_USE_MALLOC=y
# Prefer PSRAM for allocations >256 bytes (saves internal DRAM for WebRTC)
CONFIG_SPIRAM_MALLOC_ALWAYSINTERNAL=256
CONFIG_SPIRAM_MALLOC_RESERVE_INTERNAL=32768
CONFIG_SPIRAM_ALLOW_BSS_SEG_EXTERNAL_MEMORY=y
CONFIG_SPIRAM_ALLOW_NOINIT_SEG_EXTERNAL_MEMORY=y
# Allocate LWIP buffers on PSRAM to free internal RAM
CONFIG_SPIRAM_TRY_ALLOCATE_WIFI_LWIP=y

# ============================================
# Flash Configuration (16MB)
# ============================================
CONFIG_ESPTOOLPY_FLASHSIZE_16MB=y
CONFIG_ESPTOOLPY_FLASHSIZE="16MB"
CONFIG_ESPTOOLPY_FLASHMODE_QIO=y
CONFIG_ESPTOOLPY_FLASHFREQ_80M=y

# ============================================
# Partition Table
# ============================================
CONFIG_PARTITION_TABLE_CUSTOM=y
CONFIG_PARTITION_TABLE_CUSTOM_FILENAME="partitions.csv"

# ============================================
# FreeRTOS Configuration
# ============================================
CONFIG_FREERTOS_HZ=1000
CONFIG_FREERTOS_UNICORE=n
CONFIG_FREERTOS_ENABLE_BACKWARD_COMPATIBILITY=y
CONFIG_FREERTOS_TIMER_TASK_STACK_DEPTH=3072

# Task Stack Sizes
CONFIG_ESP_MAIN_TASK_STACK_SIZE=8192
CONFIG_ESP_SYSTEM_EVENT_TASK_STACK_SIZE=4096

# Allow task stacks to be allocated from PSRAM
CONFIG_SPIRAM_ALLOW_STACK_EXTERNAL_MEMORY=y

# ============================================
# WiFi Configuration
# ============================================
CONFIG_ESP_WIFI_STATIC_RX_BUFFER_NUM=16
CONFIG_ESP_WIFI_DYNAMIC_RX_BUFFER_NUM=32
CONFIG_ESP_WIFI_DYNAMIC_TX_BUFFER_NUM=32
CONFIG_ESP_WIFI_AMPDU_TX_ENABLED=y
CONFIG_ESP_WIFI_AMPDU_RX_ENABLED=y
CONFIG_ESP_WIFI_NVS_ENABLED=y
CONFIG_ESP_WIFI_SOFTAP_BEACON_MAX_LEN=752

# ============================================
# Networking Configuration
# ============================================
CONFIG_LWIP_MAX_SOCKETS=16
CONFIG_LWIP_SO_REUSE=y
CONFIG_LWIP_SO_RCVBUF=y
CONFIG_LWIP_IP_FRAG=y
CONFIG_LWIP_IP_REASSEMBLY=y
CONFIG_LWIP_TCP_MSS=1436
CONFIG_LWIP_TCP_SND_BUF_DEFAULT=32768
CONFIG_LWIP_TCP_WND_DEFAULT=32768

# ============================================
# HTTP Client Configuration
# ============================================
CONFIG_ESP_HTTP_CLIENT_ENABLE_HTTPS=y
CONFIG_ESP_HTTP_CLIENT_ENABLE_BASIC_AUTH=y

# ============================================
# WebSocket Configuration
# ============================================
CONFIG_WS_TRANSPORT=y
CONFIG_WS_BUFFER_SIZE=4096

# ============================================
# TLS/SSL Configuration (优化内存占用)
# ============================================
CONFIG_ESP_TLS_USING_MBEDTLS=y

# Enable DTLS SRTP for WebRTC
CONFIG_MBEDTLS_SSL_PROTO_DTLS=y
CONFIG_MBEDTLS_SSL_DTLS_SRTP=y

# SSL buffer size - Azure requires at least 16KB for TLS handshake
CONFIG_MBEDTLS_SSL_IN_CONTENT_LEN=16384
CONFIG_MBEDTLS_SSL_OUT_CONTENT_LEN=16384

# 使用 PSRAM 分配 mbedTLS 内存 (ESP-IDF 5.x)
CONFIG_MBEDTLS_EXTERNAL_MEM_ALLOC=y
CONFIG_MBEDTLS_SSL_VARIABLE_BUFFER_LENGTH=y

# 证书 bundle
CONFIG_MBEDTLS_CERTIFICATE_BUNDLE=y
CONFIG_MBEDTLS_CERTIFICATE_BUNDLE_DEFAULT_FULL=y

# 禁用不需要的功能以节省内存
CONFIG_MBEDTLS_SSL_KEEP_PEER_CERTIFICATE=n
CONFIG_MBEDTLS_SSL_RENEGOTIATION=n

# 禁用 mbedTLS 调试日志
CONFIG_MBEDTLS_DEBUG=n

# ============================================
# I2S Configuration
# ============================================
CONFIG_I2S_ISR_IRAM_SAFE=y

# ============================================
# I2C Configuration
# ============================================
CONFIG_I2C_ISR_IRAM_SAFE=y

# ============================================
# SPI Configuration
# ============================================
CONFIG_SPI_MASTER_ISR_IN_IRAM=y

# ============================================
# LVGL Configuration
# ============================================
CONFIG_LV_COLOR_DEPTH_16=y
CONFIG_LV_COLOR_16_SWAP=y

# CRITICAL: Use C library malloc (supports PSRAM via ESP-IDF heap allocator)
# LVGL 9.x uses CONFIG_LV_USE_CLIB_MALLOC instead of CONFIG_LV_MEM_CUSTOM
CONFIG_LV_USE_DRAW_BUF_PSRAM=y
CONFIG_LV_USE_CLIB_MALLOC=y
CONFIG_LV_USE_CLIB_STRING=y
CONFIG_LV_USE_CLIB_SPRINTF=y

# ✔ Step 6: 降低 LVGL 刷新频率到 30ms
CONFIG_LV_DISP_DEF_REFR_PERIOD=30
CONFIG_LV_INDEV_DEF_READ_PERIOD=30
CONFIG_LV_TICK_CUSTOM=y
CONFIG_LV_USE_LOG=n
CONFIG_LV_USE_PERF_MONITOR=n
CONFIG_LV_USE_MEM_MONITOR=n

# LVGL Font Configuration
CONFIG_LV_FONT_MONTSERRAT_14=y
CONFIG_LV_FONT_MONTSERRAT_16=y
CONFIG_LV_FONT_MONTSERRAT_18=y
CONFIG_LV_FONT_MONTSERRAT_20=y
CONFIG_LV_FONT_MONTSERRAT_24=y
CONFIG_LV_FONT_MONTSERRAT_28=y
CONFIG_LV_FONT_MONTSERRAT_32=y
CONFIG_LV_FONT_DEFAULT_MONTSERRAT_16=y

# LVGL Widget Configuration
CONFIG_LV_USE_ARC=y
CONFIG_LV_USE_BAR=y
CONFIG_LV_USE_BTN=y
CONFIG_LV_USE_BTNMATRIX=y
CONFIG_LV_USE_CANVAS=y
CONFIG_LV_USE_CHECKBOX=y
CONFIG_LV_USE_DROPDOWN=y
CONFIG_LV_USE_IMG=y
CONFIG_LV_USE_LABEL=y
CONFIG_LV_USE_LINE=y
CONFIG_LV_USE_ROLLER=y
CONFIG_LV_USE_SLIDER=y
CONFIG_LV_USE_SWITCH=y
CONFIG_LV_USE_TEXTAREA=y
CONFIG_LV_USE_TABLE=y
CONFIG_LV_USE_ANIMIMG=y
CONFIG_LV_USE_SPINNER=y
CONFIG_LV_USE_TILEVIEW=y

# ============================================
# ESP-ADF Audio Configuration
# ============================================
CONFIG_AUDIO_BOARD_CUSTOM=y

# ✔ Step 4: 禁用 AEC/NS/VAD (节省内部 RAM)
# Disable AFE (Audio Front-End) to save internal RAM
# AFE includes AEC (Acoustic Echo Cancellation), NS (Noise Suppression), VAD (Voice Activity Detection)
CONFIG_AFE_INTERFACE_V1=n
CONFIG_MODEL_IN_SPIFFS=n
CONFIG_USE_AFE_MODEL=n

# Audio HAL
CONFIG_DAC_OUTPUT_I2S_MODE=y

# Audio Processing - Keep equalizer (minimal RAM impact)
CONFIG_AUDIO_ENABLE_EQUALIZER=y

# ============================================
# Console/Logging Configuration
# ============================================
CONFIG_ESP_CONSOLE_UART_DEFAULT=y
CONFIG_ESP_CONSOLE_UART_BAUDRATE=115200
CONFIG_LOG_DEFAULT_LEVEL_INFO=y
CONFIG_LOG_DEFAULT_LEVEL=3
CONFIG_LOG_MAXIMUM_LEVEL_DEBUG=y
CONFIG_LOG_COLORS=y

# ============================================
# Power Management
# ============================================
CONFIG_PM_ENABLE=n

# ============================================
# Watchdog Configuration
# ============================================
# Disable watchdog panic to match webrtc_openai working sample
# AEC FIR filter processing can temporarily block CPU 0 IDLE task
CONFIG_ESP_TASK_WDT_PANIC=n
CONFIG_ESP_TASK_WDT_TIMEOUT_S=5
CONFIG_ESP_INT_WDT=y
CONFIG_ESP_INT_WDT_TIMEOUT_MS=300

# ============================================
# Heap Configuration
# ============================================
CONFIG_HEAP_POISONING_DISABLED=y
CONFIG_HEAP_TRACING_OFF=y

# ============================================
# NVS Configuration
# ============================================
CONFIG_NVS_ENCRYPTION=n

# ============================================
# Boot Configuration
# ============================================
CONFIG_BOOTLOADER_LOG_LEVEL_INFO=y
CONFIG_BOOTLOADER_LOG_LEVEL=3
CONFIG_BOOTLOADER_APP_ROLLBACK_ENABLE=n

# ============================================
# Optimization Configuration
# ============================================
CONFIG_COMPILER_OPTIMIZATION_PERF=y
```
